/*
 * Copyright (c) 2024 Nordic Semiconductor ASA
 *
 * SPDX-License-Identifier: LicenseRef-Nordic-5-Clause
 */
/ {
	aliases {
		led0 = &led1;
	};
};
	// &led0 {
// 	gpios = <&gpio 9 GPIO_ACTIVE_HIGH>;
// };
