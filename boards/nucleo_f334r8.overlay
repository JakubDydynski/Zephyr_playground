/*
 * Copyright (c) 2024 Nordic Semiconductor ASA
 *
 * SPDX-License-Identifier: LicenseRef-Nordic-5-Clause
 */
/ {
	aliases {
		led0 = &green_led_2;
	};
};
	// &led0 {
// 	gpios = <&gpio 9 GPIO_ACTIVE_HIGH>;
// };
