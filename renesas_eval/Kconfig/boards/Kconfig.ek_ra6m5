## renesas_eval/Kconfig/boards/Kconfig.ek_ra6m5
```kconfig
# Load board Kconfig descriptions.
osource "C:/ncs/v2.9.0/zephyr/boards/renesas/ek_ra6m5/Kconfig.ek_ra6m5"
```

## renesas_eval/blinky/Kconfig/boards/Kconfig.defconfig
```kconfig
# Load Zephyr board defconfig descriptions.
osource "C:/ncs/v2.9.0/zephyr/boards/renesas/ek_ra6m5/Kconfig.defconfig"
```

## renesas_eval/blinky/Kconfig/boards/Kconfig.sysbuild
```kconfig
# Load Sysbuild board Kconfig descriptions.
osource "C:/ncs/v2.9.0/zephyr/boards/renesas/ek_ra6m5/Kconfig.sysbuild"
```

## stm32_eval/Kconfig/Kconfig.shield
```kconfig
osource "C:/ncs/wkspc/example/blinky_pwm/boards/shields/*/Kconfig.shield"
osource "C:/ncs/wkspc/example/blinky_pwm_1/boards/shields/*/Kconfig.shield"
osource "C:/ncs/wkspc/example/blinky/boards/shields/*/Kconfig.shield"
```

## stm32_eval/Kconfig/boards/Kconfig.nucleo_f334r8
```kconfig
# Load board Kconfig descriptions.
osource "C:/ncs/v2.9.0/zephyr/boards/st/nucleo_f334r8/Kconfig.nucleo_f334r8"
```

## stm32_eval/blinky/Kconfig/Kconfig.shield.defconfig
```kconfig
osource "C:/ncs/wkspc/example/blinky_pwm/boards/shields/*/Kconfig.defconfig"
osource "C:/ncs/wkspc/example/blinky_pwm_1/boards/shields/*/Kconfig.defconfig"
osource "C:/ncs/wkspc/example/blinky/boards/shields/*/Kconfig.defconfig"
```

## stm32_eval/blinky/Kconfig/boards/Kconfig.defconfig
```kconfig
# Load Zephyr board defconfig descriptions.
osource "C:/ncs/v2.9.0/zephyr/boards/st/nucleo_f334r8/Kconfig.defconfig"
```
